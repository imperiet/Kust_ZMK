## config/boards/shields/kust/Kconfig.defconfig
```kconfig
if SHIELD_KUST_LEFT

config ZMK_KEYBOARD_NAME
    default "Kust"


config ZMK_SPLIT_ROLE_CENTRAL
	default y

endif

if SHIELD_KUST_LEFT||SHIELD_KUST_RIGHT

config ZMK_SPLIT
    default y

endif
```

## config/boards/shields/kust/Kconfig.shield
```kconfig
config SHIELD_KUST_LEFT
    def_bool $(shields_list_contains,kust_left)

config SHIELD_KUST_RIGHT
    def_bool $(shields_list_contains,kust_right)
```
